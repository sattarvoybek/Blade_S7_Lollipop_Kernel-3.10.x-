/* Copyright (c) 2013, The Linux Foundation. All rights reserved.
 *
 * This program is free software; you can redistribute it and/or modify
 * it under the terms of the GNU General Public License version 2 and
 * only version 2 as published by the Free Software Foundation.
 *
 * This program is distributed in the hope that it will be useful,
 * but WITHOUT ANY WARRANTY; without even the implied warranty of
 * MERCHANTABILITY or FITNESS FOR A PARTICULAR PURPOSE.  See the
 * GNU General Public License for more details.
 */

/*---------------------------------------------------------------------------
 * This file is autogenerated file using gcdb parser. Please do not edit it.
 * Update input XML file to add a new entry or update variable in this file
 * VERSION = "1.0"
 *---------------------------------------------------------------------------*/
&mdss_mdp {
	dsi_sharp_nt35695_1080p_cmd: qcom,mdss_dsi_sharp_nt35695_1080p_cmd {
		qcom,mdss-dsi-panel-name = "sharp nt35695 1080p cmd mode dsi panel";
		qcom,cont-splash-enabled;
		qcom,mdss-dsi-panel-controller = <&mdss_dsi0>;
		qcom,mdss-dsi-panel-type = "dsi_cmd_mode";
		qcom,mdss-dsi-panel-destination = "display_1";
		qcom,mdss-dsi-panel-framerate = <60>;
		qcom,mdss-dsi-virtual-channel-id = <0>;
		qcom,mdss-dsi-stream = <0>;
		qcom,mdss-dsi-panel-width = <1080>;
		qcom,mdss-dsi-panel-height = <1920>;
		qcom,mdss-dsi-h-front-porch = <128>;
		qcom,mdss-dsi-h-back-porch = <76>;
		qcom,mdss-dsi-h-pulse-width = <2>;
		qcom,mdss-dsi-h-sync-skew = <0>;
		qcom,mdss-dsi-v-back-porch = <4>;
		qcom,mdss-dsi-v-front-porch = <4>;
		qcom,mdss-dsi-v-pulse-width = <2>;
		qcom,mdss-dsi-h-left-border = <0>;
		qcom,mdss-dsi-h-right-border = <0>;
		qcom,mdss-dsi-v-top-border = <0>;
		qcom,mdss-dsi-v-bottom-border = <0>;
		qcom,mdss-dsi-bpp = <24>;
		qcom,mdss-dsi-color-order = "rgb_swap_rgb";
		qcom,mdss-dsi-underflow-color = <0xff>;
		qcom,mdss-dsi-border-color = <0>;
		qcom,mdss-dsi-on-command = [29 01 00 00 00 00 02 FF 24 
29 01 00 00 00 00 02 FB 01 
29 01 00 00 00 00 02 92 95 /*set TE*/
29 01 00 00 00 00 02 2D 00 
29 01 00 00 00 00 02 FF 23 
29 01 00 00 00 00 02 FB 01 
29 01 00 00 00 00 02 07 20 
29 01 00 00 00 00 02 08 02 
15 01 00 00 00 00 02 FF 10 
15 01 00 00 00 00 02 BB 10 
15 01 00 00 00 00 02 B0 03 
15 01 00 00 00 00 02 51 00 
15 01 00 00 00 00 02 53 2C 
15 01 00 00 00 00 02 55 02
15 01 00 00 00 00 02 35 00
05 01 00 00 69 00 01 11
05 01 00 00 2D 00 01 29];
		qcom,mdss-dsi-off-command = [15 01 00 00 00 00 02 FF 10 
15 01 00 00 00 00 02 53 20 
05 01 00 00 2D 00 01 28 
05 01 00 00 69 00 01 10];
                qcom,mdss-dsi-on-command-wakeup-gesture = [29 01 00 00 00 00 02 FF 24
29 01 00 00 00 00 02 FB 01
29 01 00 00 00 00 02 92 95 /*set TE*/
29 01 00 00 00 00 02 2D 00
29 01 00 00 00 00 02 FF 23
29 01 00 00 00 00 02 FB 01
29 01 00 00 00 00 02 07 20
29 01 00 00 00 00 02 08 02
15 01 00 00 00 00 02 FF 10
15 01 00 00 00 00 02 BB 10
15 01 00 00 00 00 02 B0 03
15 01 00 00 00 00 02 51 00
15 01 00 00 00 00 02 53 2C
15 01 00 00 00 00 02 55 02
15 01 00 00 00 00 02 35 00
05 01 00 00 69 00 01 11
05 01 00 00 2D 00 01 29];
                qcom,mdss-dsi-off-command-wakeup-gesture = [15 01 00 00 00 00 02 FF 10
15 01 00 00 00 00 02 53 20
05 01 00 00 2D 00 01 28
05 01 00 00 69 00 01 10
15 01 00 00 00 00 02 4F 01];
		qcom,mdss-dsi-on-command-state = "dsi_lp_mode";
		qcom,mdss-dsi-off-command-state = "dsi_hs_mode";
                qcom,mdss-dsi-CEdefault-command = [15 01 00 00 00 00 02 FF 10
15 01 00 00 00 00 02 55 02];
        qcom,mdss-dsi-CEbright-command = [15 01 00 00 00 00 02 FF 10
15 01 00 00 00 00 02 55 82]; 
                qcom,mdss-dsi-on-command-wakeup-gesture-state = "dsi_hs_mode";
                qcom,mdss-dsi-off-command-wakeup-gesture-state = "dsi_hs_mode";
		qcom,mdss-dsi-CEdefault-command-state = "dsi_hs_mode";
                qcom,mdss-dsi-CEbright-command-state = "dsi_hs_mode";
                qcom,mdss-dsi-h-sync-pulse = <1>;
		qcom,mdss-dsi-traffic-mode = "burst_mode";
		qcom,mdss-dsi-bllp-eof-power-mode;
		qcom,mdss-dsi-bllp-power-mode;
		qcom,mdss-dsi-lane-0-state;
		qcom,mdss-dsi-lane-1-state;
		qcom,mdss-dsi-lane-2-state;
		qcom,mdss-dsi-lane-3-state;
		qcom,mdss-dsi-te-pin-select = <1>;
		qcom,mdss-dsi-te-dcs-command = <1>;
		qcom,mdss-dsi-te-check-enable;
		qcom,mdss-dsi-te-using-te-pin;
		qcom,mdss-dsi-panel-timings = [e6 38 26 00 68 6c 2a 3a 2c 03 04 00];
		qcom,mdss-dsi-t-clk-post = <0x02>;
		qcom,mdss-dsi-t-clk-pre = <0x2B>;
		qcom,mdss-dsi-bl-min-level = <10>;
		qcom,mdss-dsi-bl-max-level = <225>;
		qcom,mdss-dsi-dma-trigger = "trigger_sw";
		qcom,mdss-dsi-mdp-trigger = "none";
		qcom,mdss-dsi-bl-pmic-control-type = "bl_ctrl_dcs";
		qcom,mdss-dsi-reset-sequence = <1 20>, <0 5>, <1 20>;
		qcom,mdss-pan-physical-width-dimension = <61>;
		qcom,mdss-pan-physical-height-dimension = <109>;
	};
};
