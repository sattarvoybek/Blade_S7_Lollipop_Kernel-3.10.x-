## drivers/input/touchscreen/focaltech_tsc/Kconfig
```kconfig
#
# Focaltech FT6x36 touchscreen driver configuration
#
menuconfig TOUCHSCREEN_FT6X36
	bool "Focaltech ft6x06 touchscreen"
	default y
	help
	  Say Y here if you have a focaltech ft6x06 touchscreen connected
	  to your system.

	  If unsure, say N.
if TOUCHSCREEN_FT6X36

config TOUCHSCREEN_FT6X36_TS
	tristate "Focaltech ft6x36 core driver module"
	default y
	help
	  Say Y here to enable basic touch reporting functionalities.

	  If unsure, say N.

	  To compile this driver as a module, choose M here: the
	  module will be called synaptics_dsx_core.

config TOUCHSCREEN_FT6X36_EX_FUN
	tristate "Focaltech ft6x36 core driver module"
	default y
	help
	  Say Y here to enable basic touch reporting functionalities.

	  If unsure, say N.

	  To compile this driver as a module, choose M here: the
	  module will be called synaptics_dsx_core.

config TOUCHSCREEN_FT6X36_CTL
	tristate "Focaltech ft6x36 core driver module"
	default y
	help
	  Say Y here to enable basic touch reporting functionalities.

	  If unsure, say N.

	  To compile this driver as a module, choose M here: the
	  module will be called synaptics_dsx_core.

endif
```
